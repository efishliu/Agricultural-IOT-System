/****************************************************************************
* 文 件 名: main.c
* 作    者: Andy
* 修    订: 2013-01-08
* 版    本: 1.0
* 描    述: GPIO输出控制实验1 操作IO口控制LED灯的亮和灭
****************************************************************************/
#include <ioCC2530.h>

typedef unsigned char uchar;
typedef unsigned int  uint;

#define LED1 P1_1   
#define LED2 P1_0 
#define LED3 P1_4

/****************************************************************************
* 名    称: DelayMS()
* 功    能: 以毫秒为单位延时，系统时钟不配置时默认为16M(用示波器测量相当精确)
* 入口参数: msec 延时参数，值越大，延时越久
* 出口参数: 无
****************************************************************************/
void DelayMS(uint msec)
{ 
    uint i,j;
    
    for (i=0; i<msec; i++)
        for (j=0; j<535; j++);
}

/****************************************************************************
* 名    称: InitLed()
* 功    能: 设置LED灯相应的IO口
* 入口参数: 无
* 出口参数: 无
****************************************************************************/
void InitLed(void)
{
    P1SEL &= 0xE0;     //引脚功能选择（通用I/O）
    P1DIR |= 0x1F;     //定义为输出口   
}

/****************************************************************************
* 程序入口函数
****************************************************************************/
void main(void)
{     
    InitLed();                   //设置LED灯相应的IO口

    while(1)                     //死循环
    {      
      LED1 = 0;LED2 = 1;LED3 = 1;
      DelayMS(500);
      LED1 = 0;LED2 = 0;LED3 = 1;
      DelayMS(500);
      LED1 = 0;LED2 = 0;LED3 = 0;
      DelayMS(500);
      LED1 = 0;LED2 = 0;LED3 = 1;
      DelayMS(500);
      LED1 = 0;LED2 = 1;LED3 = 1;
      DelayMS(500);
      LED1 = 1;LED2 = 1;LED3 = 1;
      DelayMS(500);
      LED1 = 0;LED2 = 0;LED3 = 0;
      DelayMS(500);
      LED1 = 1;LED2 = 1;LED3 = 1;
      DelayMS(500);
      LED1 = 0;LED2 = 0;LED3 = 0;
      DelayMS(500);    
    }    
}
